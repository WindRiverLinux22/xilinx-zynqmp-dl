## conf/layer.conf
```bitbake
#
# Copyright (C) 2018, 2019 Wind River Systems, Inc.
#
BBFILE_COLLECTIONS += "xilinx-zynqmp-dl"
BBFILE_PATTERN_xilinx-zynqmp-dl = ""
BBFILE_PATTERN_IGNORE_EMPTY_xilinx-zynqmp-dl = "1"

# This should only be incremented on significant changes that will
# cause compatibility issues with other layers
LAYERVERSION_xilinx-zynqmp-dl = "1"

LAYERSERIES_COMPAT_xilinx-zynqmp-dl = "honister"

# We have a pre-populated downloads directory, add to PREMIRRORS
PREMIRRORS:append = " \
     .*://.*/.* file://${LAYERDIR}/downloads/ \n \
     git://.*/.* git://${LAYERDIR}/git/MIRRORNAME;protocol=file \n \
"
```
